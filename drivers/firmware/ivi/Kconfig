## drivers/firmware/ivi/Kconfig
```kconfig
menu "ivi options"
	depends on X86_64

config IVI_SHARE_MEMORY
	bool "Enable shared memory among SBL/Hyper/VM"
	default y
	help
	  This is an option for use by developers; most people should
	  say N here.  This enables the shared memory among SBL/Hyper/VM.

endmenu
```

## drivers/staging/v4l2loopback/Kconfig
```kconfig
# SPDX-License-Identifier: GPL-2.0
config VIDEO_V4L2LOOPBACK
	tristate "v4l2loopback driver"
	default m
	depends on X86
	help
	  This is the v4l2loopback driver.
```
